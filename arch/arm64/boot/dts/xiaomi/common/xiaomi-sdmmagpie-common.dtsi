/* Copyright (c) 2018, The Linux Foundation. All rights reserved.
 * Copyright (C) 2020 The LineageOS Project
 *
 * This program is free software; you can redistribute it and/or modify
 * it under the terms of the GNU General Public License version 2 and
 * only version 2 as published by the Free Software Foundation.
 *
 * This program is distributed in the hope that it will be useful,
 * but WITHOUT ANY WARRANTY; without even the implied warranty of
 * MERCHANTABILITY or FITNESS FOR A PARTICULAR PURPOSE.  See the
 * GNU General Public License for more details.
 */

#include "xiaomi-sdmmagpie.dtsi"
#include "xiaomi-sdmmagpie-qrd.dtsi"

#include "xiaomi-sdmmagpie-audio.dtsi"
#include "xiaomi-sdmmagpie-display.dtsi"
#include "xiaomi-sdmmagpie-gpu.dtsi"
#include "xiaomi-sdmmagpie-ir.dtsi"
#include "xiaomi-sdmmagpie-leds.dtsi"
#include "xiaomi-sdmmagpie-memory.dtsi"
#include "xiaomi-sdmmagpie-nfc.dtsi"
#include "xiaomi-sdmmagpie-pinctrl.dtsi"
#include "xiaomi-sdmmagpie-pm6150.dtsi"
#include "xiaomi-sdmmagpie-pm6150l.dtsi"
#include "xiaomi-sdmmagpie-pm8009.dtsi"
#include "xiaomi-sdmmagpie-regulator.dtsi"
#include "xiaomi-sdmmagpie-usb.dtsi"
#include "xiaomi-sdmmagpie-vidc.dtsi"

&soc {
    restart@c264000 {
        qcom,force-warm-reboot;
    };
};
